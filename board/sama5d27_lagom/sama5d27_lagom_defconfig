## board/sama5d27_lagom/sama5d27_lagom_defconfig
```kconfig
CONFIG_SAMA5D27_LAGOM=y
CONFIG_RAM_128MB=y
CONFIG_SDCARD=y
CONFIG_SDHC1=y
CONFIG_JUMP_ADDR="0x23f00000"
CONFIG_DEBUG=y
# CONFIG_ENTER_NWD is not set
CONFIG_ACT8865_SET_VOLTAGE=y
# CONFIG_DISABLE_ACT8865_I2C is not set
# CONFIG_SUSPEND_ACT8945A_CHARGER is not set
```
